## drivers/i2c/chips/Kconfig
```kconfig
#
# Miscellaneous I2C chip drivers configuration
#
# *** DEPRECATED! Do not add new entries! See Makefile ***
#

menu "Miscellaneous I2C Chip support"

config SENSORS_MT9T013
	tristate "MT9T013 Camera Driver"
	depends on I2C
	default y
	help
	 MT9T013 Camera Driver implemented by HTC.

config SENSORS_MICROP_NG
        tristate "MicroP driver for HTC Phones"
        depends on I2C_MSM
        default y
        help
          If you say yes here you get support for the MicroP-LED chip
          driver which controls LEDs and other miscellaneous functions
          on some HTC devices.

          This driver can also be built as a module.  If so, the module
          will be called microp-ng.


config SENSORS_KXSD9
	tristate "Kionix KXSD9 i2c Chip Driver"
	depends on I2C_MSM
	default n
	help
	  If you say yes here, you get support for the Kionix-KXSD9 chip 
	  driver which controls the 3-axis accelerometer found in the 
	  HTC Raphael (Touch Pro) and HTC Diamond mobile phones.

endmenu
```

## drivers/video/msm/Kconfig
```kconfig
config FB_MSM
	tristate
	depends on FB && ARCH_MSM
	select FB_CFB_FILLRECT
	select FB_CFB_COPYAREA
	select FB_CFB_IMAGEBLIT
	default y

config FB_MSM_REFRESH
	bool "Enable MSM Framebuffer Refresh Thread"
	depends on FB_MSM
	default n
	---help---
	  The refresh thread will constantly perform a full screen
	  update. This is neccesary when using X with the default
	  fbdev driver.

config MSMFB_FBIOBLANK
        bool "Enable FBIOBLANK ioctl for MSM Framebuffer"
	depends on FB_MSM
        default n
	---help---
	  Enabling this experimental option enables the FBIOBLANK ioctl
          for the MSM Framebuffer driver.
	  FBIOBLANK is an ioctl that permit the userspace to
          power on or off the display without the need of suspend/resume
	  If unsure, say N.

config FB_MSM_LEGACY_MDP
	bool
	depends on FB_MSM && (MSM_MDP31 || MSM_MDP22)
	default y

config FB_MSM_MDP_PPP
	bool
	depends on FB_MSM_LEGACY_MDP
	default y

config FB_MSM_LCDC
	bool "Support for integrated LCD controller in qsd8x50"
	depends on FB_MSM && MSM_MDP31
	default y

config FB_MSM_MDDI
	bool "Support for MSM MDDI controllers"
	depends on FB_MSM
	default y

config GPU_MSM_KGSL
	tristate "MSM 3D Graphics driver for Adreno class GPUs"
	default n
	depends on FB_MSM && (ARCH_QSD8X50 || ARCH_MSM7X30)
	select GENERIC_ALLOCATOR
	select CONFIG_FW_LOADER
	help
	  3D graphics driver for QSD8x50 and MSM7x27. Required to
	  use hardware accelerated OpenGL ES 2.0 and 1.1 on these
	  chips.

config MSM_KGSL_MMU
	bool "Turn on MMU for graphics driver "
	depends on GPU_MSM_KGSL && MMU
	default n
	help
	  If enabled, the GPU driver will allocate memory from vmalloc
	  and enable the use of GPU MMU, instead of using pmem.
```
